## base_external/Config.in
```kconfig
menu "Project base packages"
source "$BR2_EXTERNAL_project_base_PATH/package/aesd-assignments/Config.in"
source "$BR2_EXTERNAL_project_base_PATH/package/aesd-assignment5/Config.in"
source "$BR2_EXTERNAL_project_base_PATH/package/aesd-assignment8/Config.in"

source "$BR2_EXTERNAL_project_base_PATH/package/ldd/Config.in"

endmenu
```

## base_external/package/aesd-assignment5/Config.in
```kconfig
config BR2_PACKAGE_AESD_ASSIGNMENT5
	bool "aesd-assignment5"
	help
	  Includes assignment5 files.
```

## base_external/package/aesd-assignment8/Config.in
```kconfig
config BR2_PACKAGE_AESD_ASSIGNMENT8
	bool "aesd-assignment8"
	help
	  Includes assignment 8 files.
```
